## conf/layer.conf
```bitbake
BBPATH .= ":${LAYERDIR}"
BBFILES += " \
    ${LAYERDIR}/recipes-*/*/*.bb \
    ${LAYERDIR}/recipes-*/*/*.bbappend \
"
BBFILE_COLLECTIONS += "axiom"
BBFILE_PATTERN_axiom = "^${LAYERDIR}/"
BBFILE_PRIORITY_axiom = "20"
LAYERSERIES_COMPAT_axiom = "wrynose"
LAYERDEPENDS_axiom = " \
    core \
    openembedded-layer \
    tegra \
    ros-common-layer \
    ros2-layer \
    ros2-jazzy-layer \
    swupdate \
"
```
